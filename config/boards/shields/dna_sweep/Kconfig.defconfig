## config/boards/shields/dna_sweep/Kconfig.defconfig
```kconfig
# Copyright (c) 2022 The ZMK Contributors
# SPDX-License-Identifier: MIT

if SHIELD_DNA_SWEEP_LEFT

config ZMK_KEYBOARD_NAME
	default "DNA Sweep"

config ZMK_SPLIT_BLE_ROLE_CENTRAL
	default y

endif

if SHIELD_DNA_SWEEP_LEFT || SHIELD_DNA_SWEEP_RIGHT

config ZMK_SPLIT
	default y

endif
```

## config/boards/shields/dna_sweep/Kconfig.shield
```kconfig
# Copyright (c) 2022 The ZMK Contributors
# SPDX-License-Identifier: MIT

config SHIELD_DNA_SWEEP_LEFT
	def_bool $(shields_list_contains,dna_sweep_left)

config SHIELD_DNA_SWEEP_RIGHT
	def_bool $(shields_list_contains,dna_sweep_right)
```

## config/west.yml
```yaml
manifest:
  remotes:
    - name: zmkfirmware
      url-base: https://github.com/zmkfirmware
    - name: andrewjrae
      url-base: https://github.com/andrewjrae
  projects:
    - name: zmk
      remote: andrewjrae
      revision: min-prior-ms
      import: app/west.yml
  self:
    path: config
```
